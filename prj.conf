## CMakeLists.txt
```
cmake_minimum_required(VERSION 3.20.0)
find_package(Zephyr REQUIRED HINTS $ENV{ZEPHYR_BASE})

project(coap_mqtt_comparison)

target_include_directories(app PRIVATE src)

target_sources(app PRIVATE src/main.c)

target_sources_ifdef(CONFIG_NRF_CLOUD_COAP app PRIVATE src/cloud_coap.c)
```

## Kconfig
```
config CLOUD_POLL_INTERVAL
    int "How often to poll the device shadow, in seconds"
    default 60

config SHADOW_BUFFER_SIZE
    int "How big buffer to allocate for the shadow"
    default 1024

module = CLOUD_DISPLAY
module-str = Cloud display
source "${ZEPHYR_BASE}/subsys/logging/Kconfig.template.log_config"

menu "Zephyr Kernel"
source "Kconfig.zephyr"
endmenu 
```

## prj.conf
```kconfig
# Logging
CONFIG_NRF_MODEM_LIB_TRACE=n
CONFIG_LOG=y
CONFIG_SERIAL=y
CONFIG_THREAD_NAME=y

CONFIG_NRF_CLOUD_LOG_LEVEL_DBG=y
CONFIG_NET_LOG=y
CONFIG_COAP_LOG_LEVEL_DBG=y
CONFIG_CLOUD_DISPLAY_LOG_LEVEL_DBG=y
CONFIG_LTE_LINK_CONTROL_LOG_LEVEL_DBG=n
CONFIG_NRF_PROVISIONING_LOG_LEVEL_DBG=y

# Modem
CONFIG_NRF_MODEM_LIB=y
CONFIG_NEWLIB_LIBC=y
CONFIG_MAIN_STACK_SIZE=2048
CONFIG_HEAP_MEM_POOL_SIZE=8192

CONFIG_NETWORKING=y
CONFIG_NET_SOCKETS=y
CONFIG_NET_SOCKETS_OFFLOAD=y
CONFIG_NET_SOCKETS_POSIX_NAMES=y

CONFIG_LTE_LINK_CONTROL=y
CONFIG_LTE_NETWORK_MODE_LTE_M=y
CONFIG_LTE_PSM_REQ=n

# nRF Cloud CoAP
CONFIG_NRF_CLOUD_SEC_TAG=111
CONFIG_NRF_CLOUD_CLIENT_ID_SRC_INTERNAL_UUID=y
CONFIG_MODEM_JWT=y
CONFIG_NRF_CLOUD_COAP=y
CONFIG_NEWLIB_LIBC_FLOAT_PRINTF=y

CONFIG_COAP_CLIENT_BLOCK_SIZE=1024
CONFIG_COAP_CLIENT_STACK_SIZE=6144
CONFIG_COAP_EXTENDED_OPTIONS_LEN_VALUE=40

# nRF Provisioning
CONFIG_MODEM_KEY_MGMT=y
CONFIG_MODEM_ATTEST_TOKEN=y
CONFIG_DATE_TIME=y

CONFIG_NRF_PROVISIONING=y
CONFIG_NRF_PROVISIONING_COAP=y
CONFIG_NRF_PROVISIONING_ROOT_CA_SEC_TAG=111110
CONFIG_COAP_EXTENDED_OPTIONS_LEN=y
CONFIG_COAP_EXTENDED_OPTIONS_LEN_VALUE=64
CONFIG_COAP_CLIENT_MESSAGE_SIZE=1536
CONFIG_NRF_PROVISIONING_AUTO_INIT=n
CONFIG_NRF_PROVISIONING_CODEC=y
CONFIG_NRF_PROVISIONING_CBOR=y
CONFIG_ZCBOR=y
CONFIG_ZCBOR_CANONICAL=y
CONFIG_NRF_PROVISIONING_CBOR_RECORDS=20
CONFIG_NRF_PROVISIONING_RX_BUF_SZ=2048

CONFIG_SETTINGS=y
CONFIG_SETTINGS_FCB=y
CONFIG_FCB=y
CONFIG_FLASH_MAP=y
CONFIG_FLASH=y
CONFIG_FLASH_PAGE_LAYOUT=y

CONFIG_MODEM_INFO=y
CONFIG_MODEM_INFO_ADD_DEVICE=n
CONFIG_MODEM_INFO_ADD_NETWORK=n
CONFIG_MODEM_INFO_ADD_SIM=n
```

## src/main.c
```c
#include <zephyr/kernel.h>
#include <zephyr/logging/log.h>
#include <modem/nrf_modem_lib.h>
#include <modem/lte_lc.h>
#include <modem/modem_key_mgmt.h>
#include <net/nrf_provisioning.h>
#include <zephyr/sys/reboot.h>
#include <cJSON.h>

#include "nrf_provisioning_at.h"

#include "cloud.h"

LOG_MODULE_REGISTER(main, CONFIG_CLOUD_DISPLAY_LOG_LEVEL); 


K_SEM_DEFINE(lte_connected, 0, 1);
K_SEM_DEFINE(provisioning_complete, 0, 1);

static struct nrf_provisioning_dm_change dmode;
static struct nrf_provisioning_mm_change mmode;

static void lte_handler(const struct lte_lc_evt *const evt)
{
	switch (evt->type) {
	case LTE_LC_EVT_NW_REG_STATUS:
		if ((evt->nw_reg_status != LTE_LC_NW_REG_REGISTERED_HOME) &&
		    (evt->nw_reg_status != LTE_LC_NW_REG_REGISTERED_ROAMING)) {
			break;
		}

		LOG_INF("Network registration status: %s",
		       evt->nw_reg_status == LTE_LC_NW_REG_REGISTERED_HOME ?
		       "Connected - home network" : "Connected - roaming");
		k_sem_give(&lte_connected);
		break;
	case LTE_LC_EVT_RRC_UPDATE:
		LOG_INF("RRC mode: %s",
		       evt->rrc_mode == LTE_LC_RRC_MODE_CONNECTED ?
		       "Connected" : "Idle");
		break;
	case LTE_LC_EVT_CELL_UPDATE:
		LOG_INF("LTE cell changed: Cell ID: %d, Tracking area: %d\n",
		       evt->cell.id, evt->cell.tac);
		break;
	case LTE_LC_EVT_MODEM_EVENT:
		LOG_INF("Modem event: %d", evt->modem_evt);
		break;
	default:
		break;
	}
}

static int modem_mode_cb(enum lte_lc_func_mode new_mode, void *user_data)
{
	enum lte_lc_func_mode fmode;
	char time_buf[64];
	int ret;

	ARG_UNUSED(user_data);

	if (lte_lc_func_mode_get(&fmode)) {
		LOG_ERR("Failed to read modem functional mode");
		ret = -EFAULT;
		return ret;
	}

	if (fmode == new_mode) {
		ret = fmode;
	} else if (new_mode == LTE_LC_FUNC_MODE_NORMAL) {
		/* Use the blocking call, because in next step
		 * the service will create a socket and call connect()
		 */
		ret = lte_lc_connect();

		if (ret) {
			LOG_ERR("lte_lc_connect() failed %d", ret);
		}
		LOG_INF("Modem connection restored");

		LOG_INF("Waiting for modem to acquire network time...");

		do {
			k_sleep(K_SECONDS(3));
			ret = nrf_provisioning_at_time_get(time_buf, sizeof(time_buf));
		} while (ret != 0);

		LOG_INF("Network time obtained");
		ret = fmode;
	} else {
		ret = lte_lc_func_mode_set(new_mode);
		if (ret == 0) {
			LOG_INF("Modem set to requested state %d", new_mode);
			ret = fmode;
		}
	}

	return ret;
}

static void reboot_device(void)
{
	/* Disconnect from network gracefully */
	int ret = lte_lc_func_mode_set(LTE_LC_FUNC_MODE_OFFLINE);

	if (ret != 0) {
		LOG_ERR("Unable to set modem offline, error %d", ret);
	}

	sys_reboot(SYS_REBOOT_WARM);
}

static void device_mode_cb(enum nrf_provisioning_event event, void *user_data)
{
	ARG_UNUSED(user_data);

	switch (event) {
	case NRF_PROVISIONING_EVENT_START:
		LOG_INF("Provisioning started");
		break;
	case NRF_PROVISIONING_EVENT_STOP:
		LOG_INF("Provisioning stopped");
		k_sem_give(&provisioning_complete);
		break;
	case NRF_PROVISIONING_EVENT_DONE:
		LOG_INF("Provisioning done, rebooting...");
		reboot_device();
		break;
	default:
		LOG_WRN("Unknown event");
		break;
	}
}

int main(void)
{
    int err;

    mmode.cb = modem_mode_cb;
		mmode.user_data = NULL;
		dmode.cb = device_mode_cb;
		dmode.user_data = NULL;

    LOG_INF("nRF Cloud CoAP display demo started");
    LOG_INF("Polling interval: %d minutes", CONFIG_CLOUD_POLL_INTERVAL);

    err = nrf_modem_lib_init();
    if (err) {
        LOG_ERR("Modem initialization failed: %d", err);
        return 1;
    }

    err = lte_lc_connect_async(lte_handler);
    if (err) {
        LOG_ERR("Failed to start network connection: %d", err);
        return 1;
    }

    k_sem_take(&lte_connected, K_FOREVER);

		err = nrf_provisioning_init(&mmode, &dmode);
		if (err) {
			LOG_ERR("Failed to initialize provisioning client");
		}

		k_sem_take(&provisioning_complete, K_FOREVER);
		LOG_INF("Provisioning complete");

		cloud_thread();
    return 0;
}
```

## src/cloud.h
```c
#ifndef __CLOUD_H__
#define __CLOUD_H__

int cloud_thread(void);

#endif /* __CLOUD_H__ */
```

## src/cloud_coap.c
```c
#include <zephyr/kernel.h>
#include <zephyr/logging/log.h>

#include <net/nrf_cloud_coap.h>
#include <cJSON.h>

#include "cloud.h"

LOG_MODULE_REGISTER(cloud, CONFIG_CLOUD_DISPLAY_LOG_LEVEL);

static void shadow_poll_timer_handler(struct k_timer *id);

K_SEM_DEFINE(shadow_poll_sem, 0, 1);
K_TIMER_DEFINE(shadow_poll_timer, shadow_poll_timer_handler, NULL);

char shadow_buffer[CONFIG_SHADOW_BUFFER_SIZE];

static void shadow_poll_timer_handler(struct k_timer *id)
{
    k_sem_give(&shadow_poll_sem);
}

/* display_string will be pointing to the string value inside the cJSON object,
    and will be freed together with input */
static int parse_config(cJSON *input, char **display_string)
{
    if (input == NULL) {
        return -EINVAL;
    }

    LOG_DBG("Shadow:\n%s", cJSON_Print(input));

    cJSON *config = cJSON_GetObjectItem(input, "config");
    if (config == NULL) {
        LOG_ERR("Could not find config object");
        return -1;
    }
    
    cJSON *display = cJSON_GetObjectItem(config, "display");
    if (display == NULL) {
        LOG_ERR("Could not find display config");
        return -1;
    }

    *display_string = cJSON_GetStringValue(display);
    return 0;
}

/* json is an allocated string that must be freed by the caller */
static int encode_config(char *display_string, char **json)
{
    if (display_string == NULL) {
        return -EINVAL;
    }

    cJSON *root = cJSON_CreateObject();
    if (root == NULL) {
        LOG_ERR("Failed to create root object");
        return -1;
    }

    cJSON *config = cJSON_CreateObject();
    if (config == NULL) {
        LOG_ERR("Failed to create config object");
        return -1;
    }

    cJSON_AddItemToObject(root, "config", config);

    if (cJSON_AddStringToObject(config, "display", display_string) == NULL) {
        LOG_ERR("Failed to add display string");
        cJSON_Delete(root);
        return -1;
    }

    *json = cJSON_Print(root);
    if (json == NULL) {
        LOG_ERR("Failed to print JSON string");
        cJSON_Delete(root);
        return -1;
    }

    cJSON_Delete(root);
    return 0;
}

int cloud_thread(void)
{
    int err;

    LOG_INF("Cloud thread started");
    
    err = nrf_cloud_coap_init();
    if (err) {
        LOG_ERR("Failed to init nRF Cloud CoAP: %d", err);
        return err;
    }

    err = nrf_cloud_coap_connect(NULL);
    if (err) {
        LOG_ERR("Failed to connect to nRF Cloud");
        return err;
    }

    LOG_DBG("Setting initial config");
    char *json = NULL;
    err = encode_config("", &json);
    if (err || json == NULL) {
        LOG_ERR("Failed to encode default config. err: %d, json: %p", err, json);
        return err;
    }

    err = nrf_cloud_coap_shadow_state_update(json);
    if (err) {
        LOG_ERR("Failed to update shadow state: %d", err);
        return err;
    }
    free(json);
    json = NULL;

    k_timer_start(&shadow_poll_timer, K_NO_WAIT, K_SECONDS(CONFIG_CLOUD_POLL_INTERVAL));

    while (true) {
        k_sem_take(&shadow_poll_sem, K_FOREVER);

        LOG_INF("Getting shadow");
        err = nrf_cloud_coap_shadow_get(shadow_buffer, CONFIG_SHADOW_BUFFER_SIZE, true);
        if (err) {
            LOG_ERR("Failed to get shadow delta: %d", err);
            continue;
        } else if (err == 0 && strlen(shadow_buffer) == 0) {
            LOG_INF("No changes to the shadow");
            continue;
        }

        LOG_DBG("Shadow delta:\n%s\n", shadow_buffer);

        struct nrf_cloud_data shadow_delta = {
            .ptr = shadow_buffer,
            .len = strlen(shadow_buffer)
        };
        struct nrf_cloud_obj shadow_config;

        err = nrf_cloud_coap_shadow_delta_process(&shadow_delta, &shadow_config);
        if (err) {
            LOG_ERR("Failed to process shadow delta: %d", err);
            goto shadow_cleanup;
        } else if (shadow_config.type != NRF_CLOUD_OBJ_TYPE_JSON) {
            LOG_ERR("Unsupported nRF Cloud object type: %d", shadow_config.type);
            goto shadow_cleanup;
        }

        char *string = NULL;
        err = parse_config(shadow_config.json, &string);
        if (err || string == NULL) {
            LOG_ERR("Failed to parse shadow: %d", err);
            goto shadow_cleanup;
        }
        LOG_DBG("Display: %s", string);

        // Do something with the string

        // Set the string written to the display in the "reported" part of the shadow
        err = encode_config(string, &json);
        if (err || json == NULL) {
            LOG_ERR("Failed to encode default config");
            continue;
        }

        err = nrf_cloud_coap_shadow_state_update(json);
        if (err) {
            LOG_ERR("Failed to update shadow state: %d", err);
            goto json_cleanup;
        }

json_cleanup:
        free(json);
        json = NULL;
        
shadow_cleanup:
        err = nrf_cloud_obj_free(&shadow_config);
        if (err) {
            LOG_ERR("Failed to free shadow object: %d", err);
            continue;
        }
    }

    return 0;
}
```
